/ {
    /* ── Layer-Tap (&lt) 全部 ── */
    &lt {
        flavor = "hold-preferred";
        tapping-term-ms = <200>;   /* 好みに応じて 150-250 で調整 */
    };

    /* ── Mod-Tap (&mt) 全部 ── */
    &mt {
        flavor = "hold-preferred";
        quick-tap-ms = <0>;
        tapping-term-ms = <200>;
    };
};
