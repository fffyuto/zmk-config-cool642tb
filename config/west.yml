## config/west.yml
```yaml
manifest:
  remotes:
    - name: fffyuto
      url-base: https://github.com/fffyuto
    - name: telzo2000
      url-base: https://github.com/telzo2000
    - name: kot149
      url-base: https://github.com/kot149

  projects:
    - name: zmk
      remote: fffyuto
      revision: fffyuto-JIS-1
      import: app/west.yml

    - name: zmk-pmw3610-driver
      remote: telzo2000
      revision: main

    - name: zmk-layout-shift
      remote: kot149
      revision: v1

  self:
    path: config
```
